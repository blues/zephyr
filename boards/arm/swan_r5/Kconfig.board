## boards/arm/swan_r5/Kconfig.board
```kconfig
# Blues Wireless Swan board configuration

# Copyright (c) 2022 Brandon Satrom
# SPDX-License-Identifier: Apache-2.0

config BOARD_SWAN_R5
	bool "Blues Wireless Swan Development Board"
	depends on SOC_STM32L4R5XX
```

## boards/arm/swan_r5/Kconfig.defconfig
```kconfig
# Blues Wireless Swan board configuration

# Copyright (c) 2022 Blues Inc.
# SPDX-License-Identifier: Apache-2.0

if BOARD_SWAN_R5

config BOARD
	default "swan_r5"

config SWAN_STM32
  default y
  bool
  select USE_STM32_HAL_GPIO
  select USE_STM32_LL_GPIO

config SPI_STM32_INTERRUPT
	default y
	depends on SPI

if NETWORKING

config USB_DEVICE_STACK
	default y

config USB_DEVICE_NETWORK_EEM
	default y

endif # NETWORKING

endif # BOARD_SWAN_R5
```
